## boards/shields/fk40b/Kconfig.defconfig
```kconfig
# Copyright (c) 2020 The ZMK Contributors
# SPDX-License-Identifier: MIT

if SHIELD_FK40B

config ZMK_KEYBOARD_NAME
    default "FK40B"

endif
```
